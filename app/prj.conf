## CMakeLists.txt
```
# SPDX-FileCopyrightText: 2026 Muhammad Waleed Badar
# SPDX-License-Identifier: GPL-3.0-only

cmake_minimum_required(VERSION 3.20.0)
find_package(Zephyr REQUIRED HINTS $ENV{ZEPHYR_BASE})

project(app LANGUAGES C)

target_sources(app PRIVATE src/main.c src/scene.c)
```

## Kconfig
```
# SPDX-FileCopyrightText: 2026 Muhammad Waleed Badar
# SPDX-License-Identifier: GPL-3.0-only
#
# Application Kconfig entry point. Browse the options with menuconfig or
# guiconfig.

menu "Zephyr"
source "Kconfig.zephyr"
endmenu

menu "Radar video stream"

config APP_DEST_ADDR
	string "Destination address"
	default "239.192.43.78"
	help
	  IPv4 or IPv6 address the radar video is sent to. Marine installations
	  use a multicast group on the radar LAN, so any number of displays can
	  join the stream.

config APP_DEST_PORT
	int "Destination UDP port"
	default 4378
	range 1 65535

config APP_IFACE
	string "Network interface to send from"
	default ""
	help
	  Name of the interface the radar video leaves through, such as eth0.
	  Leave empty to let the network stack route the datagrams.

config APP_SAC
	int "System Area Code"
	default 1
	range 0 255

config APP_SIC
	int "System Identification Code"
	default 1
	range 0 255
	help
	  Together with the SAC, identifies this radar among the streams on the
	  network.

config APP_RADAR_NAME
	string "Radar name"
	default "Zephyr X-band radar"
	help
	  Sent in the video summary message, so a display that joins the stream
	  knows what it is looking at.

config APP_SUMMARY_PERIOD_MS
	int "Video summary period in milliseconds"
	default 1000
	range 100 60000

endmenu

menu "Antenna and receiver"

config APP_ANTENNA_RPM
	int "Antenna speed in revolutions per minute"
	default 24
	range 1 120
	help
	  Marine navigation radars turn at 24 to 48 rpm. The azimuth of every
	  spoke follows the clock at this rate, as it would follow the shaft
	  encoder of a real antenna.

config APP_SPOKES_PER_REV
	int "Spokes per revolution"
	default 2048
	range 1 65536
	help
	  Number of video messages per antenna revolution. With the antenna
	  speed this sets the message rate: 24 rpm and 2048 spokes give about
	  820 messages per second.

config APP_RANGE_CELLS
	int "Range cells per spoke"
	default 1024
	range 1 1400
	help
	  Number of 8 bit cells in each spoke. One spoke must fit the library's
	  transmit buffer, ASTERIX_CAT240_TX_BUF_SIZE, with room for the message
	  header, and it is built on the main thread stack.

config APP_CELL_DUR_NS
	int "Range cell duration in nanoseconds"
	default 100
	range 1 1000000
	help
	  Round trip time of one range cell: 100 ns is a 15 m cell, so 1024
	  cells reach 15.4 km. Changing the range scale means changing this
	  value or the number of cells, not the message format.

endmenu

module = APP
module-str = APP
source "subsys/logging/Kconfig.template.log_config"
```

## prj.conf
```kconfig
CONFIG_NETWORKING=y
CONFIG_NET_IPV4=y
CONFIG_NET_IPV6=n
CONFIG_NET_UDP=y
CONFIG_NET_SOCKETS=y
CONFIG_POSIX_API=y

# Boards without an entropy driver, such as the QEMU targets, need this.
CONFIG_TEST_RANDOM_GENERATOR=y

CONFIG_NET_CONFIG_SETTINGS=y
CONFIG_NET_CONFIG_NEED_IPV4=y
CONFIG_NET_CONFIG_MY_IPV4_ADDR="192.0.2.1"
CONFIG_NET_CONFIG_MY_IPV4_NETMASK="255.255.255.0"
CONFIG_NET_CONFIG_PEER_IPV4_ADDR="192.0.2.2"

CONFIG_ASTERIX_CAT240=y
CONFIG_ASTERIX_CAT240_TX_BUF_SIZE=1472

CONFIG_LOG=y

# The stream, one spoke of APP_RANGE_CELLS and the summary text live on the
# main thread stack.
CONFIG_MAIN_STACK_SIZE=8192
```

## cartesian.conf
```kconfig
# Kconfig fragment sending the Cartesian test pattern, see the README.

CONFIG_APP_CARTESIAN=y
```

## debug.conf
```kconfig
# Kconfig fragment enabling debug related options, see the README.

# compiler
CONFIG_DEBUG_OPTIMIZATIONS=y

# logging
CONFIG_APP_LOG_LEVEL_DBG=y
```

## boards/native_sim_native_64.conf
```kconfig
# Board fragment for native_sim/native/64: use the Native Simulator offloaded
# sockets driver, so the sample sends through the host's sockets and needs no
# TAP interface.

CONFIG_ETH_NATIVE_TAP=n
CONFIG_NET_DRIVERS=y
CONFIG_NET_SOCKETS_OFFLOAD=y
CONFIG_NET_NATIVE_OFFLOADED_SOCKETS=y
```

## src/main.c
```c
/*
 * SPDX-FileCopyrightText: 2026 Muhammad Waleed Badar
 *
 * SPDX-License-Identifier: GPL-3.0-only
 */

/*
 * Marine radar video source. Behaves like the video processor of a
 * navigation radar: the antenna turns at a fixed speed, every spoke is sent
 * as one video message the moment its azimuth comes round, and a video
 * summary names the radar once a second. The echoes come from a synthetic
 * scene; a product replaces scene_radial() with its receiver's samples.
 */

#include <stdbool.h>

#include <zephyr/app_version.h>
#include <zephyr/kernel.h>
#include <zephyr/logging/log.h>
#include <zephyr/sys/printk.h>

#include <asterix/cat240.h>

#include "scene.h"

LOG_MODULE_REGISTER(main, CONFIG_APP_LOG_LEVEL);

#define SPOKES          ((uint32_t)CONFIG_APP_SPOKES_PER_REV)
#define USEC_PER_MINUTE 60000000ULL
/* One antenna revolution and one spoke, in microseconds. */
#define REV_US          (USEC_PER_MINUTE / CONFIG_APP_ANTENNA_RPM)
#define SPOKE_US        (REV_US / SPOKES)
/* Range cell depth: c * cell_dur / 2 is 0.15 m per nanosecond. */
#define CELL_M          ((CONFIG_APP_CELL_DUR_NS * 3U + 10U) / 20U)

#define SUMMARY_MAX 128

static void send_summary(struct asterix_cat240 *stream, const char *text)
{
	int ret = asterix_cat240_send_summary(stream, text);

	if (ret < 0) {
		LOG_WRN("Summary not sent (%d)", ret);
	}
}

static int run(struct asterix_cat240 *stream)
{
	uint8_t cells[CONFIG_APP_RANGE_CELLS];
	char summary[SUMMARY_MAX];
	struct scene scene = {.cell_m = CELL_M};
	struct asterix_cat240_video video = {
		.start_rg = 0,
		.cell_dur = CONFIG_APP_CELL_DUR_NS,
		.resolution = ASTERIX_CAT240_RES_HIGH,
		.cells = cells,
		.len = sizeof(cells),
	};
	int64_t start = k_uptime_ticks();
	uint64_t sent = 0;
	uint64_t next_summary_us = 0;
	uint32_t dropped = 0;
	uint32_t errors = 0;

	snprintk(summary, sizeof(summary), "%s: %u rpm, %u spokes, %u cells of %u m",
		 CONFIG_APP_RADAR_NAME, CONFIG_APP_ANTENNA_RPM, SPOKES, CONFIG_APP_RANGE_CELLS,
		 CELL_M);

	while (true) {
		uint64_t now_us = k_ticks_to_us_floor64(k_uptime_ticks() - start);
		/* Spokes the antenna has swept so far. */
		uint64_t due = (now_us * SPOKES) / REV_US;

		/* The antenna does not wait: a full revolution behind, skip to the present. */
		if (due > (sent + SPOKES)) {
			dropped += (uint32_t)(due - sent);
			sent = due;
		}

		while (sent < due) {
			uint32_t spoke = (uint32_t)(sent % SPOKES);
			uint32_t revolution = (uint32_t)(sent / SPOKES);
			int ret;

			scene.revolution = revolution;
			scene_radial(&scene,
				     (uint16_t)((spoke * ASTERIX_CAT240_AZIMUTH_STEPS) / SPOKES),
				     cells, sizeof(cells));

			video.start_az =
				(uint16_t)((spoke * ASTERIX_CAT240_AZIMUTH_STEPS) / SPOKES);
			/* The last spoke ends at 360 degrees, which wraps to 0. */
			video.end_az =
				(uint16_t)(((spoke + 1U) * ASTERIX_CAT240_AZIMUTH_STEPS) / SPOKES);

			ret = asterix_cat240_send_video(stream, &video);
			if (ret < 0) {
				errors++;
				LOG_DBG("Spoke %u not sent (%d)", spoke, ret);
			}

			sent++;

			if (spoke == (SPOKES - 1U)) {
				LOG_INF("Revolution %u: %u spokes, %u dropped, %u send errors",
					revolution, SPOKES, dropped, errors);
			}
		}

		if (now_us >= next_summary_us) {
			send_summary(stream, summary);
			next_summary_us += (uint64_t)CONFIG_APP_SUMMARY_PERIOD_MS * 1000U;
		}

		k_usleep((int32_t)SPOKE_US);
	}

	return 0;
}

int main(void)
{
	struct asterix_cat240 stream;
	const struct asterix_cat240_config config = {
		.addr = CONFIG_APP_DEST_ADDR,
		.port = CONFIG_APP_DEST_PORT,
		.iface = CONFIG_APP_IFACE,
		.sac = CONFIG_APP_SAC,
		.sic = CONFIG_APP_SIC,
	};
	int ret;

	LOG_INF("ASTERIX Category 240 radar video source %s", APP_VERSION_STRING);
	LOG_INF("%u rpm, %u spokes per revolution, %u cells of %u m", CONFIG_APP_ANTENNA_RPM,
		SPOKES, CONFIG_APP_RANGE_CELLS, CELL_M);

	ret = asterix_cat240_init(&stream, &config);
	if (ret < 0) {
		LOG_ERR("Cannot open the stream to %s:%u (%d)", config.addr, config.port, ret);
		return 0;
	}

	return run(&stream);
}
```

## src/scene.c
```c
/*
 * SPDX-FileCopyrightText: 2026 Muhammad Waleed Badar
 *
 * SPDX-License-Identifier: GPL-3.0-only
 */

#include "scene.h"

#define AZ_FULL    65536U
#define AZ_HALF    32768U
#define AZ_DEG(d)  ((uint32_t)(d) * AZ_FULL / 360U)
/* Azimuth units per radian, 65536 / (2 * pi). */
#define AZ_PER_RAD 10430U

/* Sea clutter reaches this far from own ship. */
#define CLUTTER_M    2500U
#define CLUTTER_PEAK 140U

/* Land returns fade from this amplitude with distance behind the coast. */
#define LAND_PEAK     230U
#define LAND_FADE_MIN 90U
#define LAND_FADE_M   80U

#define TARGET_PEAK 255U
#define TARGET_EDGE 160U
#define NO_LAND     UINT32_MAX

/* A vessel or a buoy, as the radar sees it from own ship. */
struct target {
	uint32_t bearing;   /* azimuth units */
	uint32_t range_m;   /* at revolution 0 */
	uint32_t length_m;  /* extent across the beam */
	uint32_t depth_m;   /* extent in range */
	uint32_t closing_m; /* range lost per revolution */
	uint32_t closest_m; /* where an approaching vessel turns back */
};

/* Cheap integer hash for noise, clutter speckle and land texture. */
static uint32_t hash(uint32_t key)
{
	uint32_t x = key;

	x ^= x >> 16;
	x *= 0x7feb352dU;
	x ^= x >> 15;
	x *= 0x846ca68bU;
	x ^= x >> 16;

	return x;
}

/* Triangle wave over the azimuth, 0 to 1024 and back once per turn of x. */
static uint32_t triangle(uint32_t phase)
{
	uint32_t x = phase & (AZ_FULL - 1U);

	return (x < AZ_HALF) ? (x / 32U) : ((AZ_FULL - x) / 32U);
}

static uint32_t max_u32(uint32_t a, uint32_t b)
{
	return (a > b) ? a : b;
}

/* Signed azimuth difference, -32768 to 32767. */
static int32_t azimuth_diff(uint32_t a, uint32_t b)
{
	uint32_t wrapped = (a - b + AZ_HALF) & (AZ_FULL - 1U);

	return (int32_t)wrapped - (int32_t)AZ_HALF;
}

/* Range of the coastline on this bearing, or NO_LAND on open sea. */
static uint32_t coast_range_m(uint16_t azimuth)
{
	/* Distance from north, 0 to 180 degrees. */
	uint32_t from_north = (azimuth < AZ_HALF) ? azimuth : (AZ_FULL - azimuth);
	uint32_t range_m;

	if (from_north > AZ_DEG(70)) {
		range_m = NO_LAND;
	} else {
		/* Headlands and bays from two triangle waves of different periods. */
		range_m = 5000U + ((triangle((uint32_t)azimuth * 3U) * 2000U) / 1024U) +
			  ((triangle((uint32_t)azimuth * 11U) * 600U) / 1024U);

		/* The coast recedes east and west of the bay own ship lies in. */
		if (from_north > AZ_DEG(45)) {
			range_m += ((from_north - AZ_DEG(45)) * 400U) / AZ_DEG(1);
		}
	}

	return range_m;
}

static uint32_t target_amplitude(const struct target *t, uint32_t revolution, uint16_t azimuth,
				 uint32_t range_m)
{
	uint32_t amplitude = 0U;
	uint32_t centre_m = t->range_m;
	uint32_t half_depth = t->depth_m / 2U;

	if (t->closing_m != 0U) {
		uint32_t travel_m =
			(revolution * t->closing_m) % (2U * (t->range_m - t->closest_m));

		/* Approach, then open out again, so the target never leaves the picture. */
		if (travel_m > (t->range_m - t->closest_m)) {
			travel_m = (2U * (t->range_m - t->closest_m)) - travel_m;
		}
		centre_m -= travel_m;
	}

	if (((range_m + half_depth) >= centre_m) && (range_m <= (centre_m + half_depth))) {
		/* Half the angle the target subtends, at least the 2 degree beam width. */
		uint32_t half_width =
			max_u32((t->length_m * AZ_PER_RAD) / (2U * centre_m), AZ_DEG(1));
		int32_t daz = azimuth_diff(azimuth, t->bearing);

		if (daz < 0) {
			daz = -daz;
		}

		if ((uint32_t)daz <= half_width) {
			amplitude = TARGET_PEAK -
				    (((uint32_t)daz * (TARGET_PEAK - TARGET_EDGE)) / half_width);
		}
	}

	return amplitude;
}

void scene_radial(const struct scene *scene, uint16_t azimuth, uint8_t *cells, size_t n)
{
	static const struct target targets[] = {
		/* A tanker at anchor off the coast. */
		{.bearing = AZ_DEG(118), .range_m = 4200U, .length_m = 90U, .depth_m = 60U},
		/* A fishing boat. */
		{.bearing = AZ_DEG(212), .range_m = 1800U, .length_m = 18U, .depth_m = 45U},
		/* A ferry closing in at 20 knots, 25 m per revolution at 24 rpm. */
		{.bearing = AZ_DEG(76),
		 .range_m = 6800U,
		 .length_m = 60U,
		 .depth_m = 60U,
		 .closing_m = 25U,
		 .closest_m = 1200U},
		/* A channel buoy. */
		{.bearing = AZ_DEG(22), .range_m = 900U, .length_m = 6U, .depth_m = 45U},
	};
	uint32_t coast_m = coast_range_m(azimuth);
	uint32_t spoke_key = (uint32_t)azimuth << 16;
	uint32_t sea_key = spoke_key ^ (scene->revolution * 0x9E3779B9U);

	for (size_t r = 0U; r < n; r++) {
		uint32_t range_m = (uint32_t)r * scene->cell_m;
		uint32_t sea = hash(sea_key ^ (uint32_t)r);
		uint32_t amplitude = sea & 0x0FU; /* receiver noise */

		if (range_m < CLUTTER_M) {
			/* Sea clutter: strong close in, speckled, new every revolution. */
			uint32_t level = ((CLUTTER_M - range_m) * CLUTTER_PEAK) / CLUTTER_M;

			amplitude = max_u32(amplitude, (level * ((sea >> 8) & 0xFFU)) / 255U);
		}

		if (range_m >= coast_m) {
			/* Land: a bright edge fading inland, with a texture that stays put. */
			uint32_t fade = (range_m - coast_m) / LAND_FADE_M;
			uint32_t level = (fade < (LAND_PEAK - LAND_FADE_MIN)) ? (LAND_PEAK - fade)
									      : LAND_FADE_MIN;
			uint32_t texture = 160U + (hash(spoke_key ^ (uint32_t)r) & 0x5FU);

			amplitude = max_u32(amplitude, (level * texture) / 255U);
		} else {
			for (size_t t = 0U; t < (sizeof(targets) / sizeof(targets[0])); t++) {
				amplitude = max_u32(amplitude,
						    target_amplitude(&targets[t], scene->revolution,
								     azimuth, range_m));
			}
		}

		cells[r] = (uint8_t)((amplitude > 255U) ? 255U : amplitude);
	}
}
```

## src/scene.h
```c
/*
 * SPDX-FileCopyrightText: 2026 Muhammad Waleed Badar
 *
 * SPDX-License-Identifier: GPL-3.0-only
 */

/*
 * Synthetic marine radar scene: sea clutter around own ship, a coastline
 * to the north and a few vessels, one of them approaching. Integer
 * arithmetic only, so it runs on any Cortex-M without a floating point unit.
 */

#ifndef APP_SCENE_H_
#define APP_SCENE_H_

#include <stddef.h>
#include <stdint.h>

#ifdef __cplusplus
extern "C" {
#endif

struct scene {
	/** Depth of one range cell in metres. */
	uint32_t cell_m;
	/** Completed antenna revolutions; moves the vessels and churns the sea. */
	uint32_t revolution;
};

/**
 * @brief Fill one spoke of 8 bit video cells
 *
 * @param scene Scene parameters.
 * @param azimuth Spoke azimuth in 1/65536 of a turn, clockwise from north.
 * @param cells Output cells, the first one at own ship.
 * @param n Number of cells.
 */
void scene_radial(const struct scene *scene, uint16_t azimuth, uint8_t *cells, size_t n);

#ifdef __cplusplus
}
#endif

#endif /* APP_SCENE_H_ */
```
